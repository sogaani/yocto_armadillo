## build/conf/bblayers.conf
```bitbake
# POKY_BBLAYERS_CONF_VERSION is increased each time build/conf/bblayers.conf
# changes incompatibly
POKY_BBLAYERS_CONF_VERSION = "2"

BBPATH = "${TOPDIR}"
BBFILES ?= ""

BBLAYERS ?= " \
  /home/sogaani/yocto/poky/meta \
  /home/sogaani/yocto/poky/meta-poky \
  /home/sogaani/yocto/poky/meta-yocto-bsp \
  /home/sogaani/yocto/meta-openembedded/meta-oe \
  /home/sogaani/yocto/meta-swupdate \
  /home/sogaani/yocto/meta-armadillo \
  "
```

## meta-armadillo/conf/layer.conf
```bitbake
# We have a conf and classes directory, append to BBPATH
BBPATH .= ":${LAYERDIR}"

# We have a recipes directory containing .bb and .bbappend files, add to BBFILES
BBFILES += "${LAYERDIR}/recipes*/*/*.bb \
            ${LAYERDIR}/recipes*/*/*.bbappend"

BBFILE_COLLECTIONS += "armadillo"
BBFILE_PATTERN_armadillo := "^${LAYERDIR}/"
BBFILE_PRIORITY_armadillo = "9"
```

## meta-armadillo/conf/machine/armadillo-g3.conf
```bitbake
TARGET_ARCH="arm"
TUNE_ARCH="arm"
PREFERRED_PROVIDER_virtual/kernel ??= "linux-armadillo-g3"
PREFERRED_PROVIDER_virtual/bootloader ??= "u-boot-armadillo-g3"
MACHINE_FEATURES = "pci ext3 serial wifi"
MACHINE_EXTRA_RRECOMMENDS += " kernel-modules"
KERNEL_CLASSES += "kernel-fitimage"
KERNEL_DEVICETREE = "armadillo_iotg_g3_m1.dtb"
KERNEL_IMAGETYPE = "fitImage"
UBOOT_MACHINE = "x1_config"
UBOOT_BINARY = "u-boot-x1.bin"
require conf/machine/include/tune-armadillo-g3.inc
```

## meta-armadillo/conf/machine/armadillo-iot-g3-m1.conf
```bitbake
TARGET_ARCH="arm"
TUNE_ARCH="arm"
PREFERRED_PROVIDER_virtual/kernel ??= "linux-armadillo-iot-g3"
PREFERRED_PROVIDER_virtual/bootloader ??= "u-boot-armadillo-iot-g3"
PREFERRED_PROVIDER_virtual/initscripts-swupdate ??= "initscripts-swupdate-rootfs"
MACHINE_FEATURES = "pci ext3 serial wifi"
MACHINE_EXTRA_RRECOMMENDS += " kernel-modules"
KERNEL_CLASSES += "kernel-fitimage"
KERNEL_DEVICETREE = "armadillo_iotg_g3_m1.dtb"
KERNEL_IMAGETYPES = "uImage"
UBOOT_MACHINE = "x1_config"
UBOOT_BINARY = "u-boot-x1.bin"
require conf/machine/include/tune-armadillo-iot-g3.inc
```
